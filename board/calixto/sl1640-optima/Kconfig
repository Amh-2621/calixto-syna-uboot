## board/calixto/sl1640-optima/Kconfig
```kconfig
if TARGET_SL1640_OPTIMA

config SYS_BOARD
	default "sl1640-optima"

config SYS_CONFIG_NAME
	default "sl1640-optima"

endif
```

## board/synaptics/sl1680-optima/Kconfig
```kconfig
if TARGET_SL1680_OPTIMA

config SYS_BOARD
	default "sl1680-optima"

config SYS_CONFIG_NAME
	default "sl1680-optima"

endif
```
